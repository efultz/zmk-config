## boards/shields/concave_granite/Kconfig.defconfig
```kconfig
# Copyright (c) 2021 The ZMK Contributors
# SPDX-License-Identifier: MIT
if SHIELD_CONCAVE_GRANITE_LEFT

config ZMK_KEYBOARD_NAME
    default "concave_granite"

config ZMK_SPLIT_ROLE_CENTRAL
    default y

endif

if SHIELD_CONCAVE_GRANITE_LEFT || SHIELD_CONCAVE_GRANITE_RIGHT

config ZMK_SPLIT
    default y

endif
```

## boards/shields/concave_granite/Kconfig.shield
```kconfig
# Copyright (c) 2021 The ZMK Contributors
# SPDX-License-Identifier: MIT
config SHIELD_CONCAVE_GRANITE_LEFT
    def_bool $(shields_list_contains,concave_granite_left)

config SHIELD_CONCAVE_GRANITE_RIGHT
    def_bool $(shields_list_contains,concave_granite_right)
```
